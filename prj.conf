## CMakeLists.txt
```
cmake_minimum_required(VERSION 3.8.2)

find_package(Zephyr REQUIRED HINTS $ENV{ZEPHYR_BASE})

target_sources(app PRIVATE
  src/main.c
  src/tiempo.c
)
zephyr_library_include_directories(${CMAKE_CURRENT_SOURCE_DIR}/src)

project(samples_test_app)
```

## Kconfig.sysbuild
```
#
# Copyright (c) 2023 Nordic Semiconductor
#
# SPDX-License-Identifier: LicenseRef-Nordic-5-Clause
#

config PARTITION_MANAGER
	default n

config NRF_DEFAULT_IPC_RADIO
	default y

source "${ZEPHYR_BASE}/share/sysbuild/Kconfig"
```

## prj.conf
```kconfig
# Consola y logs por USB CDC-ACM (la placa lo habilita e inicializa).
CONFIG_SERIAL=y
CONFIG_CONSOLE=y
CONFIG_UART_CONSOLE=y
CONFIG_UART_INTERRUPT_DRIVEN=y
CONFIG_LOG=y

# Bluetooth LE: rol periferico + servidor GATT.
CONFIG_BT=y
CONFIG_BT_PERIPHERAL=y
CONFIG_BT_DEVICE_NAME="XIAO-FLOW"
CONFIG_BT_MAX_CONN=1

# El host BLE hace trabajo en la workqueue del sistema.
CONFIG_SYSTEM_WORKQUEUE_STACK_SIZE=2048

CONFIG_FLASH=y
CONFIG_FLASH_MAP=y          # flash_area_open / PARTITION_ID
CONFIG_FLASH_PAGE_LAYOUT=y  # flash_get_page_info_by_offs
```

## src/main.c
```c
/*
 * Envio BLE minimo para XIAO nRF52840.
 *
 * Anuncia como XIAO-FLOW y notifica un paquete de datos simulados por segundo.
 * Sin sensor, sin GPIO, sin almacenamiento: solo el transporte.
 */

#include <zephyr/kernel.h>
#include <zephyr/logging/log.h>

#include <zephyr/bluetooth/bluetooth.h>
#include <zephyr/bluetooth/conn.h>
#include <zephyr/bluetooth/gatt.h>
#include <zephyr/bluetooth/uuid.h>

LOG_MODULE_REGISTER(flow_sim, LOG_LEVEL_INF);

#define BT_UUID_FLOW_SVC_VAL \
	BT_UUID_128_ENCODE(0xf1a70001, 0x9b4c, 0x4f3e, 0x8b6d, 0x1c2a3d4e5f60)
#define BT_UUID_FLOW_DATA_VAL \
	BT_UUID_128_ENCODE(0xf1a70002, 0x9b4c, 0x4f3e, 0x8b6d, 0x1c2a3d4e5f60)

static const struct bt_uuid_128 flow_svc_uuid  = BT_UUID_INIT_128(BT_UUID_FLOW_SVC_VAL);
static const struct bt_uuid_128 flow_data_uuid = BT_UUID_INIT_128(BT_UUID_FLOW_DATA_VAL);

/* Paquete de 10 bytes, little-endian. */
struct __packed flow_packet {
	uint16_t seq;  /* numero de secuencia: detecta notificaciones perdidas */
	uint32_t ts;   /* segundos desde el arranque                           */
	int16_t  flow; /* centesimas de ml/min (500 = 5.00 ml/min)             */
	int16_t  temp; /* centesimas de C      (2500 = 25.00 C)                */
};

static bool notify_enabled;

static void data_ccc_changed(const struct bt_gatt_attr *attr, uint16_t value)
{
	ARG_UNUSED(attr);

	notify_enabled = (value == BT_GATT_CCC_NOTIFY);
	LOG_INF("Notificaciones %s", notify_enabled ? "habilitadas" : "deshabilitadas");
}

BT_GATT_SERVICE_DEFINE(flow_svc,
	BT_GATT_PRIMARY_SERVICE(&flow_svc_uuid),
	BT_GATT_CHARACTERISTIC(&flow_data_uuid.uuid,
			       BT_GATT_CHRC_NOTIFY, BT_GATT_PERM_NONE,
			       NULL, NULL, NULL),
	BT_GATT_CCC(data_ccc_changed, BT_GATT_PERM_READ | BT_GATT_PERM_WRITE),
);

static void connected(struct bt_conn *conn, uint8_t err)
{
	ARG_UNUSED(conn);

	if (err) {
		LOG_ERR("Conexion fallida (err 0x%02x)", err);
		return;
	}

	LOG_INF("Conectado");
}

static void disconnected(struct bt_conn *conn, uint8_t reason)
{
	ARG_UNUSED(conn);

	/* El CCC se reinicia al desconectar; el flag debe seguirlo. */
	notify_enabled = false;
	LOG_INF("Desconectado (reason 0x%02x)", reason);
}

BT_CONN_CB_DEFINE(conn_callbacks) = {
	.connected = connected,
	.disconnected = disconnected,
};

static const struct bt_data ad[] = {
	BT_DATA_BYTES(BT_DATA_FLAGS, (BT_LE_AD_GENERAL | BT_LE_AD_NO_BREDR)),
	BT_DATA(BT_DATA_NAME_COMPLETE, CONFIG_BT_DEVICE_NAME,
		sizeof(CONFIG_BT_DEVICE_NAME) - 1),
};

/* El UUID de 128 bits va en el scan response: junto al nombre no cabe en los
 * 31 bytes del paquete de advertising.
 */
static const struct bt_data sd[] = {
	BT_DATA_BYTES(BT_DATA_UUID128_ALL, BT_UUID_FLOW_SVC_VAL),
};

/* Seno de 16 puntos escalado a +/-100, para no usar aritmetica flotante. */
static const int16_t sin_lut[16] = {
	0, 38, 71, 92, 100, 92, 71, 38, 0, -38, -71, -92, -100, -92, -71, -38,
};

int main(void)
{
	uint16_t seq = 0;
	int err;

	/* Margen para que el host enumere el puerto USB CDC antes de los
	 * primeros mensajes; si no, se pierden.
	 */
	k_msleep(2000);

	err = bt_enable(NULL);
	if (err) {
		LOG_ERR("bt_enable fallo (err %d)", err);
		return err;
	}

	/* En NCS 2.x esta opcion se llamaba BT_LE_ADV_OPT_CONNECTABLE. */
	err = bt_le_adv_start(BT_LE_ADV_PARAM(BT_LE_ADV_OPT_CONN,
					      BT_GAP_ADV_FAST_INT_MIN_2,
					      BT_GAP_ADV_FAST_INT_MAX_2, NULL),
			      ad, ARRAY_SIZE(ad), sd, ARRAY_SIZE(sd));
	if (err) {
		LOG_ERR("bt_le_adv_start fallo (err %d)", err);
		return err;
	}

	LOG_INF("Anunciando como %s", CONFIG_BT_DEVICE_NAME);

	while (1) {
		int16_t ripple = sin_lut[seq % ARRAY_SIZE(sin_lut)];
		struct flow_packet pkt = {
			.seq = seq++,
			.ts = (uint32_t)(k_uptime_get() / 1000),
			.flow = 500 + (ripple * 50) / 100,  /* 5.00 +/- 0.50 ml/min */
			.temp = 2500 + (ripple * 20) / 100, /* 25.00 +/- 0.20 C     */
		};

		if (notify_enabled) {
			err = bt_gatt_notify(NULL, &flow_svc.attrs[1], &pkt, sizeof(pkt));
			if (err) {
				LOG_WRN("bt_gatt_notify fallo (err %d)", err);
			} else {
				LOG_INF("seq=%u flujo=%d.%02d ml/min temp=%d.%02d C",
					pkt.seq, pkt.flow / 100, pkt.flow % 100,
					pkt.temp / 100, pkt.temp % 100);
			}
		}

		k_msleep(1000);
	}

	return 0;
}
```

## src/registro.c
```c
#include <zephyr/kernel.h>
#include <zephyr/drivers/flash.h>
#include <zephyr/logging/log.h>
#include <zephyr/storage/flash_map.h>
#include <zephyr/sys/crc.h>
#include <string.h>

#include "registro.h"

LOG_MODULE_REGISTER(registro, LOG_LEVEL_INF);
enum tipo_cmd{
	CMD_TENDENCIA, 
	CMD_EVENTO,
	CMD_FLUSH,
	CMD_BORRAR,
};

// Unión de eventos:
struct cmd {
	enum tipo_cmd tipo;
	union {
		struct reg_tendencia tendencia; 
		struct reg_evento evento;
	};
};

// Creamos el queue de 8 comandos para el thread:
K_MSGQ_DEFINE(ordenes_q, sizeof(struct cmd), 8, 4);

#define STACK_REGISTRO 2048 // stack para el thread de registros
K_THREAD_STACK_DEFINE(stack_registro, STACK_REGISTRO);
static struct k_thread thread_registro; 

//----------------------------------------------------
// Variables que describen el estado del módulo (solo el thread escritor
// los puede modificar).
// La idea de "secuencia" es anclar el último punto donde se realizó escritura
// así es posible reencontrarlo en caso que el sistema entre en reposo. 
static const struct flash_area *area_tendencia; 
static const struct flash_area *area_eventos;
static size_t bloque_borrado;

static struct pagina_tendencia buffer_pagina; // página en RAM, aún sin escribir en flash
static uint8_t  num_registros; // registros ya metidos en el buffer
static uint16_t cursor_pagina; // próxima página libre de tendencia
static uint16_t paginas_totales;
static uint16_t secuencia_siguiente;

static uint16_t cursor_evento; // próxima página libre de eventos
static uint16_t eventos_totales; 

static bool memoria_llena;
//----------------------------------------------------
// Función para reiniciar el buffer actual (todo queda en 1 cuando
// se borra en una flash)
static void reiniciar_buffer(void){
	memset(&buffer_pagina, 0xFF, sizeof(buffer_pagina));
	num_registros = 0;
}
//----------------------------------------------------
// Función para encontrar el primer espacio sin escribir de cada partición de la flash
// Si su campo vale 0xFF (REG_SEQ_VACIA), es posible escribir ahí. Además, en los eventos
// simplemente se busca que el timestamp sea REG_TS_VACIO
static int localizar_cursores(void)
{
    // Si el barrido no encuentra hueco, el cursor queda en el total (llena)
    cursor_pagina = paginas_totales;
    secuencia_siguiente = 0;

    for (uint16_t i = 0; i < paginas_totales; i++){
        uint16_t seq;
		// Cosas clave: 
		//off_t es un tipo de dato de Zephyr Signed Integer que se usa para representar
		//posiciones de memoria
		// offsetof() entrega cuántos bytes hay desde el inicio de la estructura hasta el campo seq.
        off_t off = (off_t)i * REG_PAGINA_BYTES + offsetof(struct pagina_tendencia, seq);
        int err = flash_area_read(area_tendencia, off, &seq, sizeof(seq));
        if (err){
            return err;
        }

        if (seq == REG_SEQ_VACIA){ // encontró el Byte 0xFF
            cursor_pagina = i; // Posiciona el cursor en el espacio vacío
            break;
        }
        secuencia_siguiente = (uint16_t)(seq + 1U); // Última posición llena. 
    }

    // Para evitar el caso 0xFF y que se detecte una página que no está vacía en realidad
    if (secuencia_siguiente == REG_SEQ_VACIA){
        secuencia_siguiente = 0;
    }

	// Caso análogo, pero ahora con los eventos:
    cursor_evento = eventos_totales;

    for (uint16_t i = 0; i < eventos_totales; i++){
        uint32_t ts;
        off_t off = (off_t)i * sizeof(struct reg_evento);
        int err = flash_area_read(area_eventos, off, &ts, sizeof(ts));

        if (err){
            return err;
        }

        if (ts == REG_TS_VACIO){ 
            cursor_evento = i;
            break;
        }
    }

    // Activa el flag si se llenó cualquiera de las 2 particiones
    memoria_llena = (cursor_pagina >= paginas_totales) || (cursor_evento >= eventos_totales);

    return 0;
}
//----------------------------------------------------
// Prepara el bloque de borrado en cada inicio de bloque (cada 4096 bytes)
static int preparar_bloque(const struct flash_area *area, off_t off)
{
    if ((off % (off_t)bloque_borrado) != 0){ // no es el inicio: nada que borrar
        return 0;
    }

    return flash_area_erase(area, off, bloque_borrado);
}

//----------------------------------------------------
// Función para escribir en la flash el buffer de tendencia y pasar a la pag sig.
static int cerrar_pagina(void)
{
    if (num_registros == 0){ // nada que escribir
        return 0;
    }

    if (cursor_pagina >= paginas_totales){ // memoria llena
        memoria_llena = true;
        LOG_ERR("particion de tendencia llena, se descartan %u registros", num_registros);
        buffer_reiniciar();
        return -ENOSPC;
    }
	// Definimos el offset en base al cursor ya encontrado
    off_t off = (off_t)cursor_pagina * REG_PAGINA_BYTES;
    int err = preparar_bloque(area_tendencia, off); // Borra con el offset obtenido

    if (err){
        LOG_ERR("borrado de bloque en 0x%lx fallo (err %d)", (long)off, err);
        return err;
    }

    buffer_pagina.seq = secuencia_siguiente;
    // Creamos el crc utilizando la página entera menos su propio campo: 
    buffer_pagina.crc = crc16_ansi((const uint8_t *)&buffer_pagina,
                                   REG_PAGINA_BYTES - sizeof(buffer_pagina.crc));
	
	// Escritura en la flash de la tendencia (registros)
    err = flash_area_write(area_tendencia, off, &buffer_pagina, REG_PAGINA_BYTES);
    if (err){
        LOG_ERR("escritura de pagina %u fallo (err %d)", cursor_pagina, err);
        return err;
    }

    LOG_INF("pagina %u escrita (seq=%u, %u registros)", cursor_pagina,
            buffer_pagina.seq, num_registros);

    // Avanza cursor y secuencia para próxima página:
    cursor_pagina++;
    secuencia_siguiente = (uint16_t)(secuencia_siguiente + 1U);
    if (secuencia_siguiente == REG_SEQ_VACIA){
        secuencia_siguiente = 0;
    }

    if (cursor_pagina >= paginas_totales){
        memoria_llena = true;
        LOG_WRN("particion de tendencia al limite");
    }

    buffer_reiniciar();

    return 0;
}
//----------------------------------------------------
// Función para meter un registro de tendencia en el buffer. Solo toca 
// la flash cuando la página se completa.
static int agregar_tendencia(const struct reg_tendencia *r)
{
    if (num_registros >= REG_POR_PAGINA){ // Por si acaso
        // No debería ocurrir: la página se cierra al completar el 28
        int err = cerrar_pagina();

        if (err){
            return err;
        }
    }
	// Incorporación al buffer:
    buffer_pagina.reg[num_registros++] = *r; 

    // 28 registros de 9 B completan los 252 B de datos de la página
    if (num_registros == REG_POR_PAGINA){
        return cerrar_pagina();
    }

    return 0;
}
//----------------------------------------------------
// Función para escribir un evento. A diferencia de la tendencia, los eventos
// van directo a flash: no se acumulan en RAM.
static int escribir_evento(const struct reg_evento *e)
{
    if (cursor_evento >= eventos_totales){
        memoria_llena = true;
        LOG_ERR("particion de eventos llena, evento tipo %u descartado", e->tipo);
        return -ENOSPC;
    }

    off_t off = (off_t)cursor_evento * sizeof(struct reg_evento);
    int err = preparar_bloque(area_eventos, off);

    if (err){
        return err;
    }
	// Escritura del evento en la flash:
    err = flash_area_write(area_eventos, off, e, sizeof(*e));
    if (err){
        LOG_ERR("escritura de evento %u fallo (err %d)", cursor_evento, err);
        return err;
    }

    cursor_evento++; // avanzamos a la ranura siguiente
    LOG_INF("evento tipo=%u ts=%u flags=0x%02x", e->tipo, e->ts, e->flags);

    return 0;
}
//----------------------------------------------------
// Borra las dos particiones enteras y deja los cursores en el "origen":
static int borrar_todo(void)
{	// fa_size indica el tamaño del área en bytes.
    int err = flash_area_erase(area_tendencia, 0, area_tendencia->fa_size);

    if (err){
        LOG_ERR("borrado de tendencia fallo (err %d)", err);
        return err;
    }

    err = flash_area_erase(area_eventos, 0, area_eventos->fa_size);
    if (err){
        LOG_ERR("borrado de eventos fallo (err %d)", err);
        return err;
    }

    buffer_reiniciar();
    cursor_pagina = 0;
    cursor_evento = 0;
    secuencia_siguiente = 0;
    memoria_llena = false;

    LOG_INF("registros borrados");

    return 0;
}

// Thread de escritura: el único que toca la flash. Se queda esperando en la queue
// hasta que llega un comando así no bloquea.
static void thread_escritor(void *a, void *b, void *c)
{
    ARG_UNUSED(a);
    ARG_UNUSED(b);
    ARG_UNUSED(c);

    struct cmd orden;

    while (1){
        k_msgq_get(&ordenes_q, &orden, K_FOREVER); // K_FOREVER = espera recepción

        switch (orden.tipo){
        case CMD_TENDENCIA:
            (void)agregar_tendencia(&orden.tendencia);
            break;
        case CMD_EVENTO:
            (void)escribir_evento(&orden.evento);
            // Un evento arrastra a flash el buffer parcial de tendencia, para
            // conservar los minutos previos al incidente.
            (void)cerrar_pagina();
            break;
        case CMD_FLUSH:
            (void)cerrar_pagina();
            break;
        case CMD_BORRAR:
            (void)borrar_todo();
            break;
        }
    }
}

//----------------------------------------------------
// Función para abrir las particiones, averiguar dónde quedamos y lanza el thread (0 = todo ok):
int registro_init(void)
{	// Extraemos las partitions de la flash de su respectivo mapa en 
	// tendencia y en eventos:
    int err = flash_area_open(PARTITION_ID(tendencia_partition), &area_tendencia);

    if (err){
        LOG_ERR("no se pudo abrir la particion de tendencia (err %d)", err);
        return err;
    }

    err = flash_area_open(PARTITION_ID(eventos_partition), &area_eventos);
    if (err){
        LOG_ERR("no se pudo abrir la particion de eventos (err %d)", err);
        return err;
    }

    // El tamaño del "erase block" lo sacamos del propio driver:
    struct flash_pages_info info; // struct donde vamos a sacar la información
    const struct device *dev = flash_area_get_device(area_tendencia); // nrf52840

    err = flash_get_page_info_by_offs(dev, area_tendencia->fa_off, &info); // rellena info
    if (err){
        LOG_ERR("no se pudo leer la geometria de la flash (err %d)", err);
        return err;
    }
    bloque_borrado = info.size; // bloque de borrado definido por el driver

    // Cuántos espacios (páginas) caben en cada partición:
    paginas_totales = (uint16_t)(area_tendencia->fa_size / REG_PAGINA_BYTES);
    eventos_totales = (uint16_t)(area_eventos->fa_size / sizeof(struct reg_evento));

    buffer_reiniciar();

    err = localizar_cursores();
    if (err){
        return err;
    }

    LOG_INF("tendencia: %u/%u paginas, eventos: %u/%u, bloque de borrado %u B",
            cursor_pagina, paginas_totales, cursor_evento, eventos_totales,
            (unsigned)bloque_borrado);

			// Creación y registro del thread: 
    k_thread_create(&thread_registro, stack_registro, STACK_REGISTRO,
                    thread_escritor, NULL, NULL, NULL,
                    K_PRIO_PREEMPT(10), 0, K_NO_WAIT);
    k_thread_name_set(&thread_registro, "registro");

    return 0;
}

// Mete una orden en la queue sin esperar (K_NO_WAIT): el productor nunca se
// queda bloqueado, y si la queue está saturada se reporta y se pierde.
static int encolar(const struct cmd *c)
{	// Copia los valores del struct de command (c) al buffer del queue y no espera, 
	// arroja error al tiro
    int err = k_msgq_put(&ordenes_q, c, K_NO_WAIT);

    if (err){
        LOG_ERR("cola de registro saturada, orden tipo %d perdida", c->tipo);
    }

    return err;
}
//----------------------------------------------------
// Funciones: cada una solo arma su orden y la "encola".
int registro_tendencia(const struct reg_tendencia *r)
{
    struct cmd c = { .tipo = CMD_TENDENCIA, .tendencia = *r };
    return encolar(&c);
}

int registro_evento(const struct reg_evento *e)
{
    struct cmd c = { .tipo = CMD_EVENTO, .evento = *e };
    return encolar(&c);
}

int registro_flush(void)
{
    struct cmd c = { .tipo = CMD_FLUSH };
    return encolar(&c);
}

int registro_borrar(void)
{
    struct cmd c = { .tipo = CMD_BORRAR };
    return encolar(&c);
}
//----------------------------------------------------
// estado de la memoria para quien la pida (BLE por ejemplo):
void registro_leer_estado(struct registro_estado *e)
{
    e->paginas_usadas = cursor_pagina;
    e->paginas_totales = paginas_totales;
    e->eventos_usados = cursor_evento;
    e->eventos_totales = eventos_totales;
    e->en_buffer = num_registros;
    e->llena = memoria_llena;
}
```

## src/registro.h
```c
#ifndef REGISTRO_H_
#define REGISTRO_H_

#include <zephyr/kernel.h>
#include <stdbool.h>
#include <stdint.h>

#define REG_FLAG_TIEMPO_RELATIVO BIT(0) // Propio nuestro: tiempo no sincronizado
#define REG_FLAG_FLUJO_BAJO BIT(1)
#define REG_FLAG_FLUJO_ALTO BIT(2)
#define REG_FLAG_TEMP_FUERA BIT(3)
#define REG_FLAG_BURBUJA BIT(4)
#define REG_FLAG_SENSOR_FALLA BIT(5)

#define REG_MASCARA_ALARMAS \
	(REG_FLAG_FLUJO_BAJO | REG_FLAG_FLUJO_ALTO | REG_FLAG_TEMP_FUERA | \
	 REG_FLAG_BURBUJA | REG_FLAG_SENSOR_FALLA)


// Registro de tendencia: 9 bytes.
struct __packed reg_tendencia {
	uint32_t ts;    // Unix, o segundos desde arranque si REG_FLAG_TIEMPO_RELATIVO
	int16_t  flujo; // centesimas de ml/min, promedio del minuto 
	int16_t  temp;  // centesimas de grado C, promedio del minuto
	uint8_t  flags;
};
BUILD_ASSERT(sizeof(struct reg_tendencia) == 9, "el registro de tendencia debe ser de 9 B");

enum evento_tipo {
	EVT_ARRANQUE = 1,
	EVT_TIEMPO_SINCRONIZADO,
	EVT_INFUSION_INICIO,
	EVT_INFUSION_FIN,
	EVT_ALARMA_ACTIVA,
	EVT_ALARMA_LIBERADA,
	EVT_MEMORIA_LLENA,
	EVT_REGISTROS_BORRADOS,
};

//Registro de evento: 16 bytes con el contexto del sistema en el
// instante de la transicion.
struct __packed reg_evento {
	uint32_t ts;
	uint8_t  tipo; // enum evento_tipo */
	uint8_t  flags; // estado de alarmas tras la transicion */
	int16_t  flujo;
	int16_t  temp;
	uint32_t volumen_cl; //volumen acumulado, centesimas de ml
	uint16_t crc; // CRC-16 de los 14 bytes anteriores 
};
BUILD_ASSERT(sizeof(struct reg_evento) == 16, "el registro de evento debe ser de 16 B");

 // Pagina de tendencia: 28 registros de 9 B + secuencia + CRC-16 = 256 B.
#define REG_POR_PAGINA   28
#define REG_PAGINA_BYTES 256

struct __packed pagina_tendencia {
	struct reg_tendencia reg[REG_POR_PAGINA];
	uint16_t seq;
	uint16_t crc; /* CRC-16 sobre los 254 bytes anteriores */
};
BUILD_ASSERT(sizeof(struct pagina_tendencia) == REG_PAGINA_BYTES, "la pagina debe ser de 256 B");

/* Una pagina sin escribir queda en 0xFFFF; la secuencia nunca toma ese valor. */
#define REG_SEQ_VACIA 0xFFFFU
/* Ranura de relleno en una pagina cerrada a medias: ts a 0xFFFFFFFF. */
#define REG_TS_VACIO  0xFFFFFFFFU

// Esto se usa para entregar información a BLE de la memoria:
struct registro_estado {
	uint16_t paginas_usadas;
	uint16_t paginas_totales;
	uint16_t eventos_usados;
	uint16_t eventos_totales;
	uint8_t  en_buffer; /* registros en RAM aun no escritos a flash */
	bool     llena;
};

int registro_init(void);

// Mete un registro de 9B en un buffer en la RAM y cuando completa 28 registros, 
// el buffer escribe 256B en la flash. 
int registro_tendencia(const struct reg_tendencia *r);

//Escribe un evento y fuerza escritura del buffer parcial de tendencia, para
//preservar los minutos previos al incidente.
int registro_evento(const struct reg_evento *e);

int registro_flush(void);

// Se borran los registros cuando se descarguen los datos desde la app. 
int registro_borrar(void);

void registro_leer_estado(struct registro_estado *e);

#endif /* REGISTRO_H_ */
```

## src/sensor.c
```c
#include <zephyr/logging/log.h>
#include "sensor.h"

LOG_MODULE_REGISTER(sensor, LOG_LEVEL_INF);
//----------------------------------------------------
// Función para hacer el cálculo del CRC: 
uint8_t sensor_crc8(const uint8_t *datos, size_t len)
{
    uint8_t crc = 0xFF; // Valor inicial del registro

    for (size_t i = 0; i < len; i++){
        crc ^= datos[i]; // Operación XOR elemento a elemento
        for (int bit = 0; bit < 8; bit++){ // Recorrido del byte
            // Si el MSB = 1: SR y XOR con 0x31 (del datasheet), si no, solo SR
            crc = (crc & 0x80) ? (uint8_t)((crc << 1) ^ 0x31) : (uint8_t)(crc << 1);
        }
    }
    return crc;
}
//----------------------------------------------------
// Función para decodificar información y detectar errores:
int sensor_decodificar(const uint8_t trama[SENSOR_TRAMA_BYTES], struct medicion *m)
{
    for (int campo = 0; campo < 3; campo ++){ // hay 3 campos en total, cada uno con 2 datos y un crc
        const uint8_t *puntero = &trama[campo * 3]; 
        if (sensor_crc8(puntero, 2) != puntero[2]) {// crc del campo
            LOG_WRN("CRC-8 invalido en el campo %d", campo);
            return -EIO;
        }
    }
    // Temperatura y flujo están codificadas en 16 bits:
    int16_t flujo_raw = (uint16_t)(((uint16_t)trama[0]<<8) | trama[1]);
    int16_t temp_raw = (uint16_t)(((uint16_t)trama[3]<<8) | trama[4]);

    // Transformación de los valores a unidades físicas (transformación dada por el datasheet):
	m->flujo = (int16_t)(((int32_t)flujo_raw * 100) / SENSOR_ESCALA_FLUJO);
	m->temp  = (int16_t)(((int32_t)temp_raw * 100) / SENSOR_ESCALA_TEMP);
	m->flags = ((uint16_t)trama[6] << 8) | trama[7];

    return 0; // mítico
}
//----------------------------------------------------
// Funciones para inicializar y enviar comandos:
int sensor_init(void)
{
	return sensor_tx_init();
}

int sensor_iniciar_continuo(void)
{
	return sensor_tx_cmd(SENSOR_CMD_MEDIR_CONTINUO);
}

int sensor_detener(void)
{
	return sensor_tx_cmd(SENSOR_CMD_DETENER);
}

int sensor_leer(struct medicion *m)
{
	uint8_t trama[SENSOR_TRAMA_BYTES];
	int err = sensor_tx_trama(trama);

	if (err) {
		return err;
	}

	return sensor_decodificar(trama, m);
}
```

## src/sensor.h
```c
#ifndef SENSOR_H_
#define SENSOR_H_

#include <zephyr/kernel.h>
#include <stdint.h>

// El sensor transmite 6 bytes de información 3 de redundancia
#define SENSOR_TRAMA_BYTES 9

// Definición de Macros para comandos importantes:
#define SENSOR_CMD_MEDIR_CONTINUO 0x3608U
#define SENSOR_CMD_DETENER 0x3FF9U

// Factor de escala para transformar las mediciones
#define SENSOR_ESCALA_FLUJO 500
#define SENSOR_ESCALA_TEMP 200

// Bits de la palabra de estado que devuelve el sensor: 
#define SENSOR_FLAG_BURBUJA BIT(0)
#define SENSOR_FLAG_FLUJO_ALTO BIT(1)

struct medicion {
    uint16_t flujo;
    uint16_t temp;
    uint16_t flags;
};

// Funciones que implementa la simulación del sensor (eventualmente
// el código que implemente el i2c)
int sensor_tx_init(void);
int sensor_tx_cmd(uint16_t cmd);
int sensor_tx_trama(uint8_t trama[SENSOR_TRAMA_BYTES]);

// Funciones para activar funcionalidades base del sensor:
int sensor_init(void);
int sensor_iniciar_continuo(void);
int sensor_detener(void);

// Lee la trama, detecta errores y devuelve la medición:
int sensor_leer(struct medicion *m);

uint8_t sensor_crc8(const uint8_t *datos, size_t len);
int sensor_decodificar(const uint8_t trama[SENSOR_TRAMA_BYTES],
struct medicion *m);

#endif
```

## src/tiempo.c
```c
#include <zephyr/kernel.h>
#include <zephyr/logging/log.h>
#include <zephyr/sys/clock.h>
#include <time.h>
#include "tiempo.h"

// Para printear información (por eso log_inf)
LOG_MODULE_REGISTER(tiempo, LOG_LEVEL_INF);

static bool sincronizado; // flag de sincronización
//----------------------------------------------------
// El sistema inicia no sincronizado (0 = todo ok)
int tiempo_init(void)
{
    sincronizado = false;
    return 0;
}
//----------------------------------------------------
int sincronizar_tiempo(uint64_t unix_ms)
{
    // declaramos el tiempo en segundos y en nanosegundos
    // en el struct tipo timespec que time.h trae: 
    struct timespec ts = {
        .tv_sec = (time_t)(unix_ms / MSEC_PER_SEC),
        .tv_nsec = (long)((unix_ms % MSEC_PER_SEC) * NSEC_PER_MSEC),
    };

    // anclaje del contador a la hora dada (OJO FUNCIÓN)
    int err = sys_clock_setsystem(SYS_CLOCK_REALTIME, &ts);

    if (err){// err = 1 en caso de fallar.
        LOG_ERR("sys_clock_settime fallo (err %d)", err);
        return err; 
    }

    sincronizado = true; // subimos el flag y reportamos
    LOG_INF("hora sincronizada: %llu s", (unsigned long long)ts.tv_sec);
    return 0;
}
//----------------------------------------------------
// Función a futuro: Tal vez introducir algún criterio. 
bool tiempo_valido(void)
{
    return sincronizado;
}
//----------------------------------------------------
uint32_t timestamp(void)
{
    struct timespec ts; // Declaración del struct
    // Si está sincronizado y puede medir tiempo interno:
    if (sincronizado && sys_clock_gettime(SYS_CLOCK_REALTIME, &ts)==0){
        return (uint32_t)ts.tv_sec; // Tiempo real
    }
    // Si todavía no está sincronizado, usa segundos desde arranque
    return (uint32_t)(k_uptime_get()/MSEC_PER_SEC);
}
```

## src/tiempo.h
```c
#ifndef TIEMPO_H_
#define TIEMPO_H_

#include <stdbool.h>
#include <stdint.h>

int tiempo_init(void);
int sincronizar_tiempo(uint64_t unix_ms);
bool tiempo_valido(void);
uint32_t timestamp(void); 

#endif 
```
